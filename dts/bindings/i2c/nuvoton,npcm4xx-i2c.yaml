## dts/bindings/i2c/nuvoton,npcm4xx-i2c.yaml
```yaml
# Copyright (c) 2020 Nuvoton Technology Corporation.
# SPDX-License-Identifier: Apache-2.0

description: Nuvoton, NPCM4XX-I2C controller node

compatible: "nuvoton,npcm4xx-i2c"

include: ["base.yaml", "nuvoton-pinctrl.yaml", "i2c-controller.yaml"]

properties:
    reg:
        required: true
    clocks:
        required: true
    label:
        required: true
    wait_free_time:
        type: int
        required: false
        description: time in unit of ms to wait for the bus to be idle
```
