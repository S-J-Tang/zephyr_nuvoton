## drivers/i3c/Kconfig
```kconfig
# I3C configuration options

# Copyright (c) 2023 Zephyr Inc.
# SPDX-License-Identifier: Apache-2.0
# I3C options

menuconfig I3C
	bool "I3C Drivers"
	help
	  Enable I3C Driver.

if I3C
config I3C_SHELL
	bool "Enable I3C Shell"
	default y
	depends on SHELL
	select SHELL_GETOPT
	help
	  Enable I3C Shell for testing.

module = I3C
module-str = I3C
source "subsys/logging/Kconfig.template.log_config"

source "drivers/i3c/slave/Kconfig"
source "drivers/i3c/Kconfig.aspeed"
source "drivers/i3c/Kconfig.npcm4xx"
source "drivers/i3c/Kconfig.npcm4"

endif # I3C
```

## drivers/i3c/Kconfig.npcm4
```kconfig
# Copyright (c) 2026 Nuvoton Technology Corporation.
# SPDX-License-Identifier: Apache-2.0

config I3C_NPCM4
	bool "Nuvoton NPCM400 I3C driver"
	depends on SOC_FAMILY_NPCM4XX
	help
	  Enable the Nuvoton NPCM400 I3C driver.
```

## drivers/misc/npcm/Kconfig
```kconfig
# NPCM misc. driver options

# Copyright (c) 2024 Nuvoton
# SPDX-License-Identifier: Apache-2.0


config C2H_NPCM
	bool "NPCM4XX core access to host modules driver"
	depends on SOC_FAMILY_NPCM4XX
	help
	  This option enables the c2h driver for NPCM
	  SoCs.
	  Say y if you wish to access host modules
	  on NPCM SMC.
```

## drivers/pwm/Kconfig.npcm
```kconfig
# NPCM PWM driver configuration options

# Copyright (c) 2024 Nuvoton Technology Corporation.
# SPDX-License-Identifier: Apache-2.0

config PWM_NPCM
	bool "Nuvoton NPCM Enhanced Super I/O (eSIO) PWM driver"
	default y
	depends on SOC_FAMILY_NPCM4XX && PWM
	help
	  This option enables the PWM driver for NPCM family of
	  processors.
	  Say y if you wish to use pwm ports on NPCM MCU.
```

## dts/bindings/i3c/nuvoton,npcm4-i3c.yaml
```yaml
# Copyright (c) 2026 Nuvoton Technology Corporation.
# SPDX-License-Identifier: Apache-2.0

description: NUVOTON I3C

compatible: "nuvoton,npcm4-i3c"

include: [i3c-controller.yaml, nuvoton-pinctrl.yaml]

properties:
  instance-id:
    required: true
    type: int
    description: |
      Instance ID of the device, used to specify port number

  slave:
    required: false
    type: boolean
    description: Initialized as slave (default) / master

  secondary:
    required: false
    type: boolean
    description: Initialized as a secondary master

  assigned-address:
    required: true
    type: int
    description: |
      The default address of the device

  part-id:
    required: false
    type: int
    description: |
      PID[31:16], used for bus enumeration with entdaa

  vendor-def-id:
    required: false
    type: int
    description: |
      PID[11:0], used for bus enumeration with entdaa

  bcr:
    required: false
    type: int
    description: |
      Bus Characteristics Register, used for bus enumeration with entdaa

  dcr:
    required: false
    type: int
    description: |
      Device Characteristics Register, used for bus enumeration with entdaa

  busno:
    required: true
    type: int
    description: |
      Bus Number, used for bus enumeration

  dma-tx-channel:
    required: true
    type: int
    description: |
      dma channel for write data to bus

  dma-rx-channel:
    required: true
    type: int
    description: |
      dma channel for read data from bus

  hj-request-timeout-ms:
    required: false
    type: int
    description: |
      Timeout in milliseconds for the hot-join request. If not
      sent within this period, the request is cancelled. If absent,
      no timeout is applied.

  pinctrl-0:
    type: phandles
    required: true
    description: configurations of pinmux controllers
```

## dts/bindings/pwm/nuvoton,npcm-pwm.yaml
```yaml
# Copyright (c) 2024 Nuvoton Technology Corporation.
# SPDX-License-Identifier: Apache-2.0

description: Nuvoton, NPCM Pulse Width Modulator (PWM) node

compatible: "nuvoton,npcm-pwm"

include: [pwm-controller.yaml, base.yaml, nuvoton-pinctrl.yaml]

properties:
  reg:
    required: true
  clocks:
    required: true
  label:
    required: true
  pinctrl-0:
    type: phandles
    required: true
    description: configurations of pinmux controllers
  pinctrl-names:
    type: string-array
    required: true
    description: pin configuration state names
  drive-open-drain:
    type: boolean
    description: |
      The PWM output will be configured as open-drain. If not set,
      defaults to push-pull.

pwm-cells:
  - channel
  - period
  - flags
```
